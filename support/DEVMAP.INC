; MCU BUILTIN IO

REG_DDRP2	equ	$01	; PORT 2 DDR
REG_PORT2	equ	$03	; PORT 2 I/O Address
REG_TCSR1	equ	$08	; Timer Control/Status Reg 1
REG_FRCH	equ	$09	; Free Running Counter MSB
REG_FRCL	equ	$0A	; Free Running Counter LSB
REG_OCR1H	equ	$0B	; Output Compare Reg 1 MSB
REG_OCR1L	equ	$0C	; Output Compare Reg 1 LSB
REG_TCSR2	equ	$0F	; Timer Control/Status Reg 2
REG_RMCR	equ	$10	; RATE AND MODE CONTROL REGISTER
REG_TRCSR	equ	$11	; TXD/RXD CONTROL AND STATUS REG.
REG_RDR		equ	$12	; RECEIVE DATA REGISTER
REG_TDR		equ	$13	; TRANSMIT DATA REGISTER
REG_RP5CR	equ	$14	; RAM/PORT 5 Control register

 .ifdef HD6303Y
REG_PORT5	equ	$15	; PORT 5 I/O Address
REG_DDRP6	equ	$16	; PORT 6 DDR       
REG_PORT6	equ	$17	; PORT 6 I/O Address
REG_DDRP5	equ	$20	; PORT 5 DDR
REG_TRCSR2	equ	$1E	; TXD/RXD CONTROL AND STATUS REG#2.
REG_TCSSR3	equ	$1B	; TIMER CONTROL AND STATUS REG#3.
REG_TCONR	equ	$1C	; TIMER2 CONSTANT REG.
REG_T2CNT	equ	$1D	; TIMER2 COUNTER REG.

REG_TRCSR1	equ	REG_TRCSR

BIT_IRQ1E	equ	1
BIT_IRQ2E	equ	2
BIT_MRE		equ	4
BIT_HLTE	equ	8
BIT_AMRE	equ	16
BIT_STBYFLAG	equ	32
 .endif

BIT_RAME	equ	64
BIT_STBYPWR	equ	128

; EXTERNAL UART HW

UART_DATA	equ	$E6B8
UART_CONFIG	equ	$E6B9
UART_STATUS	equ	$E6B9
UART_PRESCALER	equ	$E6BA

UART_RRD	equ	$01
UART_TRD	equ	$8
UART_RIE	equ	$10
UART_TIE	equ	$20
UART_RIQ	equ	$40
UART_TIQ	equ	$80
